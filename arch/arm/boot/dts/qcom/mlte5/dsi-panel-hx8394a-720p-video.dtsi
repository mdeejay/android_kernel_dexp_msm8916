/* Copyright (c) 2013, The Linux Foundation. All rights reserved.
 *
 * This program is free software; you can redistribute it and/or modify
 * it under the terms of the GNU General Public License version 2 and
 * only version 2 as published by the Free Software Foundation.
 *
 * This program is distributed in the hope that it will be useful,
 * but WITHOUT ANY WARRANTY; without even the implied warranty of
 * MERCHANTABILITY or FITNESS FOR A PARTICULAR PURPOSE.  See the
 * GNU General Public License for more details.
 */

/*---------------------------------------------------------------------------
 * This file is autogenerated file using gcdb parser. Please do not edit it.
 * Update input XML file to add a new entry or update variable in this file
 * VERSION = "1.0"
 *---------------------------------------------------------------------------*/
&mdss_mdp {
	dsi_txd_hx8394d_720p_video: qcom,mdss_dsi_txd_hx8394d_720p_video {
		qcom,mdss-dsi-panel-name = "txd_hx8394d_HD720p_video";
		qcom,mdss-dsi-panel-controller = <&mdss_dsi0>;
		qcom,mdss-dsi-panel-type = "dsi_video_mode";
		qcom,mdss-dsi-panel-destination = "display_1";
		qcom,mdss-dsi-panel-framerate = <60>;
		qcom,mdss-dsi-virtual-channel-id = <0>;
		qcom,mdss-dsi-stream = <0>;
		qcom,mdss-dsi-panel-width = <720>;
		qcom,mdss-dsi-panel-height = <1280>;
		qcom,mdss-dsi-h-front-porch = <150>;
		qcom,mdss-dsi-h-back-porch = <150>;
		qcom,mdss-dsi-h-pulse-width = <17>;
		qcom,mdss-dsi-h-sync-skew = <0>;
		qcom,mdss-dsi-v-back-porch = <12>;
		qcom,mdss-dsi-v-front-porch = <16>;
		qcom,mdss-dsi-v-pulse-width = <4>;
		qcom,mdss-dsi-h-left-border = <0>;
		qcom,mdss-dsi-h-right-border = <0>;
		qcom,mdss-dsi-v-top-border = <0>;
		qcom,mdss-dsi-v-bottom-border = <0>;
		qcom,mdss-dsi-bpp = <24>;
		qcom,mdss-dsi-color-order = <0x0>;
		qcom,mdss-dsi-underflow-color = <0xff>;
		qcom,mdss-dsi-border-color = <0>;
		qcom,mdss-dsi-on-command = [39 01 00 00 00 
				00 04 b9 ff 83 94 39 01 00 
				00 00 00 03 ba 33 83 39 01 
				00 00 00 00 10 b1 6f 16 16 
				16 04 11 f1 81 3a 54 43 8c 
				c0 d2 58 39 01 00 00 00 00 
				0c b2 00 64 0e 0d 22 1c 08 
				08 1c 4d 00 39 01 00 00 00 
				00 0d b4 00 ff 51 5a 59 5a 
				03 5a 01 70 01 70 39 01 00 
				00 00 00 02 bc 07 39 01 00 
				00 00 00 04 bf 41 0e 01 39 
				01 00 00 00 00 26 d3 00 0f 
				00 40 07 10 00 08 10 08 00 
				08 54 15 0e 05 0e 02 15 06 
				05 06 47 44 0a 0a 4b 10 07 
				07 08 00 00 00 0a 00 01 39 
				01 00 00 00 00 2d d5 1a 1a 
				1b 1b 00 01 02 03 04 05 06 
				07 08 09 0a 0b 24 25 18 18 
				26 27 18 18 18 18 18 18 18 
				18 18 18 18 18 18 18 18 18 
				20 21 18 18 18 18 39 01 00 
				00 00 00 2d d6 1a 1a 1b 1b 
				0b 0a 09 08 07 06 05 04 03 
				02 01 00 21 20 58 58 27 26 
				18 18 18 18 18 18 18 18 18 
				18 18 18 18 18 18 18 25 24 
				18 18 18 18 39 01 00 00 00 
				00 02 cc 09 39 01 00 00 00 
				00 03 c0 30 14 39 01 00 00 
				00 00 05 c7 00 c0 40 c0 39 
				01 00 00 00 00 03 b6 6b 6b 
				39 01 00 00 00 00 2b e0 00 
				0a 0f 24 3a 3f 20 3b 08 0d 
				0e 16 0f 12 15 13 15 09 12 
				12 18 00 0a 0f 24 3a 3f 20 
				3b 08 0d 0e 16 0f 12 15 13 
				15 09 12 12 18 39 01 00 00 
				00 00 02 bd 00 39 01 00 00 
				00 00 2c c1 01 00 06 0c 14 
				1d 27 2f 38 41 49 51 59 61 
				69 71 79 81 89 91 99 a1 a9 
				b2 b9 c1 ca d1 d8 e2 ea f0 
				f7 ff 38 fc 3f 0b c1 13 f1 
				0d c0 39 01 00 00 00 00 02 
				bd 01 39 01 00 00 00 00 2b 
				c1 00 06 0c 14 1d 27 2f 38 
				41 49 51 59 61 69 71 79 81 
				89 91 99 a1 a9 b2 b9 c1 ca 
				d1 d8 e2 ea f0 f7 ff 38 fc 
				3f 0b c1 13 f1 0d c0 39 01 
				00 00 00 00 02 bd 02 39 01 
				00 00 00 00 2b c1 00 06 0c 
				14 1d 27 2f 38 41 49 51 59 
				61 69 71 79 81 89 91 99 a1 
				a9 b2 b9 c1 ca d1 d8 e2 ea 
				f0 f7 ff 38 fc 3f 0b c1 13 
				f1 0d c0 05 01 00 00 78 00 
				02 11 00 05 01 00 00 14 00 
				02 29 00];
		qcom,mdss-dsi-off-command = [05 01 00 00 32 00 02 28 00 05 01 00 00 78 00 02 10 00];
		qcom,mdss-dsi-on-command-state = "dsi_lp_mode";
		qcom,mdss-dsi-off-command-state = "dsi_hs_mode";
		qcom,mdss-dsi-h-sync-pulse = <0>;
		qcom,mdss-dsi-traffic-mode = "burst_mode";
		qcom,mdss-dsi-lane-map = "lane_map_0123";
		qcom,mdss-dsi-bllp-eof-power-mode;
		qcom,mdss-dsi-bllp-power-mode;
		qcom,mdss-dsi-lane-0-state;
		qcom,mdss-dsi-lane-1-state;
		qcom,mdss-dsi-lane-2-state;
		qcom,mdss-dsi-lane-3-state;
		qcom,mdss-dsi-panel-timings = [53 1E 14 00 44 48 18 22 19 03 04 00];
		qcom,mdss-dsi-t-clk-post = <0x1F>;
		qcom,mdss-dsi-t-clk-pre = <0x2D>;
		qcom,mdss-dsi-bl-min-level = <14>;
		qcom,mdss-dsi-bl-max-level = <255>;
		qcom,mdss-dsi-bl-pmic-pwm-frequency = <20>;
		qcom,mdss-dsi-bl-pmic-bank-select = <0>;
		qcom,mdss-dsi-dma-trigger = "trigger_sw";
		qcom,mdss-dsi-mdp-trigger = "none";
		qcom,mdss-dsi-bl-pmic-control-type = "bl_ctrl_pwm";
		qcom,mdss-dsi-pwm-gpio = <&pm8916_mpps 4 0>;
		qcom,mdss-dsi-reset-sequence = <0x1 0x14 0x0 0x2 0x1 0x14>;
		qcom,mdss-dsi-lp11-init;
		qcom,suspend-ulps-enabled;
	};
};
